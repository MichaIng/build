/dts-v1/;
/plugin/;

&spi3 {
	pinctrl-0 = <&spi3m1_cs0 &spi3m1_pins>;
	status = "okay";
	#address-cells = <1>;
	#size-cells = <0>;

	spidev@0 {
		compatible = "armbian,spi-dev";
		status = "okay";
		reg = <0>;
		spi-max-frequency = <50000000>;
	};
};
